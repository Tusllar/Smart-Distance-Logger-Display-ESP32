## sdkconfig.defaults
```kconfig
# OLED Display Configuration
CONFIG_EXAMPLE_LCD_CONTROLLER_SSD1306=y
CONFIG_EXAMPLE_SSD1306_HEIGHT=64

# I2C Configuration
CONFIG_I2C_ENABLE_DEBUG_LOG=y

# LVGL Configuration
CONFIG_LV_COLOR_DEPTH_1=y
CONFIG_LV_USE_LOG=y
CONFIG_LV_LOG_LEVEL_INFO=y

# FreeRTOS Configuration
CONFIG_FREERTOS_HZ=1000

# Memory Configuration
CONFIG_SPIRAM_SUPPORT=y
CONFIG_SPIRAM_USE_MALLOC=y

# Example Configuration
CONFIG_ESP_WIFI_SSID="4 chi em"
CONFIG_ESP_WIFI_PASSWORD="daytro6868"
CONFIG_ESP_STATION_EXAMPLE_WPA3_SAE_PWE_BOTH=y
CONFIG_ESP_WIFI_PW_ID=""
CONFIG_ESP_MAXIMUM_RETRY=5
CONFIG_ESP_WIFI_AUTH_WPA2_PSK=y
```
